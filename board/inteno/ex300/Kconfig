## board/inteno/ex300/Kconfig
```kconfig
if TARGET_EX300

config SYS_BOARD
	default "ex300"

config SYS_VENDOR
	default "inteno"

config SYS_CONFIG_NAME
	default "ex300"
endif
```

## board/inteno/ex400/Kconfig
```kconfig
if TARGET_EX400

config SYS_BOARD
	default "ex400"

config SYS_VENDOR
	default "inteno"

config SYS_CONFIG_NAME
	default "ex400"

menu "inteno"

config INTENO_MAJOR
       string "Major version for inteno"
       default "0"

config INTENO_MINOR
       string "Minor version for inteno"
       default "0"

endmenu
endif
```

## board/mediatek/mt7621/Kconfig
```kconfig
if TARGET_MT7621

config SYS_BOARD
	default "mt7621"

config SYS_VENDOR
	default "mediatek"

config SYS_CONFIG_NAME
	default "mt7621"

endif
```

## configs/mt7621_defconfig
```kconfig
CONFIG_MIPS=y
CONFIG_TARGET_MT7621=y
CONFIG_HUSH_PARSER=y
CONFIG_SYS_PROMPT="mt7621 # "
# CONFIG_CMD_LOADB is not set
# CONFIG_CMD_LOADS is not set
# CONFIG_CMD_FPGA is not set
# CONFIG_CMD_SETEXPR is not set
CONFIG_CMD_DHCP=y
# CONFIG_CMD_NFS is not set
CONFIG_CMD_PING=y
CONFIG_SYS_NS16550=y
CONFIG_USE_PRIVATE_LIBGCC=y
```
